## config/west.yml
```yaml
manifest:
  remotes:
  - name: zmkfirmware
    url-base: https://github.com/zmkfirmware
  - name: carrefinho
    url-base: https://github.com/carrefinho
  projects:
  - name: zmk
    remote: zmkfirmware
    revision: main
    import: app/west.yml
  # - name: zmk-keyboards-totem
  #   url: https://github.com/victorlucachi/zmk-keyboards-totem
  #   revision: main
  #   path: modules/zmk-keyboards-totem
  - name: prospector-zmk-module
    remote: carrefinho
    revision: core/zephyr-4-1
  self:
    path: config
```
